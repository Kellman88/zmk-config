## config/boards/shields/dac_man_5x6/Kconfig.shield
```kconfig
config SHIELD_DAC_MAN_6X6_LEFT
    def_bool $(shields_list_contains,dac_man_6x6_left)

config SHIELD_DAC_MAN_6X6_RIGHT
    def_bool $(shields_list_contains,dac_man_6x6_right)
```

## config/boards/shields/dac_man_6x6/Kconfig.defconfig
```kconfig
if SHIELD_DAC_MAN_6X6_LEFT

config ZMK_KEYBOARD_NAME
    default "Dac-Man-6x6"

config ZMK_SPLIT_BLE_ROLE_CENTRAL
    default y

endif

if SHIELD_DAC_MAN_6X6_RIGHT

config ZMK_KEYBOARD_NAME
    default "Dac-Man-5x6-R"

endif

if SHIELD_DAC_MAN_6X6_LEFT || SHIELD_DAC_MAN_6X6_RIGHT

config ZMK_SPLIT
    default y
endif
```
